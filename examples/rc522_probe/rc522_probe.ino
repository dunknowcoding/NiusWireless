/*
 * rc522_probe — extended dictionary probe for "unknown" keycards.
 *
 * Tries a much larger dictionary than rc522_recover (Proxmark3's
 * default ~120-key list plus common UID-derived patterns and
 * well-known access-control defaults), reports which keys worked
 * against which sectors, and tests BOTH Key A and Key B.
 *
 * Useful before investing in a full Crypto1 port — many "unknown"
 * cards turn out to have keys that live in the dictionary or follow
 * a vendor pattern. If rc522_probe reaches >75% sectors, you may
 * not need static_nested at all.
 *
 * --- Wiring same as rc522_recover ---
 */

#include <NiusWireless.h>

#define RC522_CS_PIN    SDA
#define RC522_RST_PIN   10
#define RC522_SCK_PIN   SCL
#define RC522_MOSI_PIN  11
#define RC522_MISO_PIN  12

NiusRC522 rfid(RC522_CS_PIN, RC522_RST_PIN, RC522_SCK_PIN, RC522_MOSI_PIN, RC522_MISO_PIN);

static const uint8_t dict[][6] = {
    {0xFF,0xFF,0xFF,0xFF,0xFF,0xFF},
    {0x00,0x00,0x00,0x00,0x00,0x00},
    {0xA0,0xA1,0xA2,0xA3,0xA4,0xA5},
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    {0xAB,0x44,0x21,0x44,0x8A,0xAB},
};
static const uint8_t dictLen = sizeof(dict) / sizeof(dict[0]);

static void printHex(const uint8_t *b, uint8_t n) {
    for (uint8_t i = 0; i < n; i++) {
        if (b[i] < 0x10) Serial.print('0');
        Serial.print(b[i], HEX);
        if (i + 1 < n) Serial.print(' ');
    }
}

static bool probeSector(const uint8_t dict[][6], uint8_t dictLen,
                        uint8_t s, bool &hitA, uint8_t keyAout[6],
                        bool &hitB, uint8_t keyBout[6]) {
    hitA = hitB = false;
    uint8_t trailer = (uint8_t)(s * 4 + 3);
    for (uint8_t k = 0; k < dictLen; k++) {
        if (!hitA && rfid.authenticate(trailer, NIUS_KEY_A, (uint8_t *)dict[k]) == NIUS_OK) {
            if (keyAout) memcpy(keyAout, dict[k], 6);
            rfid.stopCrypto();
            hitA = true;
            if (hitB) break;
        }
        rfid.stopCrypto();
        if (!hitB && rfid.authenticate(trailer, NIUS_KEY_B, (uint8_t *)dict[k]) == NIUS_OK) {
            if (keyBout) memcpy(keyBout, dict[k], 6);
            rfid.stopCrypto();
            hitB = true;
            if (hitA) break;
        }
        rfid.stopCrypto();
    }
    return hitA || hitB;
}

void setup() {
    Serial.begin(9600);
    delay(1500);
    Serial.println(F("NiusWireless — RC522 Extended Key Probe"));
    Serial.println(F("======================================="));
    if (!rfid.begin()) {
        Serial.println(F("ERROR: RC522 not found."));
        while (1) { delay(500); }
    }
    Serial.print(F("Reader: "));
    Serial.println(rfid.getVersion());
    Serial.println(F("Place a MIFARE Classic card on the reader..."));
}

void loop() {
    if (!rfid.cardPresentWake()) { return; }

    Serial.println();
    Serial.println(F("------------------------------ Tag detected ------------------------------"));
    uint8_t uidBuf[10]; uint8_t uidLen = 0;
    rfid.getUIDBytes(uidBuf, uidLen);
    Serial.print  (F("UID:  ")); printHex(uidBuf, uidLen); Serial.println();
    Serial.print  (F("Type: ")); Serial.println(rfid.getCardTypeName());

    uint8_t ct = rfid.getCardType();
    if (ct != NIUS_CARD_MIFARE_1K &&
        ct != NIUS_CARD_MIFARE_4K &&
        ct != NIUS_CARD_MIFARE_MINI) {
        Serial.println(F("Not a MIFARE Classic card — key recovery N/A."));
        rfid.halt();
        delay(1000);
        return;
    }
    uint16_t tried = 0;
    bool hitA[16] = {}, hitB[16] = {};
    uint8_t kA[16][6], kB[16][6];

    Serial.print(F("Trying ")); Serial.print(dictLen);
    Serial.print(F(" keys x 16 sectors (both KeyA, KeyB)..."));
    uint32_t t0 = millis();
    for (uint8_t s = 0; s < 16; s++) {
        probeSector(dict, dictLen, s, hitA[s], kA[s], hitB[s], kB[s]);
        tried += dictLen;
    }
    uint32_t elapsed = millis() - t0;
    Serial.print(F(" done. Tried ")); Serial.print(tried);
    Serial.print(F(" in ")); Serial.print(elapsed);
    Serial.println(F(" ms."));

    uint8_t hits = 0;
    Serial.println();
    Serial.println(F("Per-sector result:"));
    for (uint8_t s = 0; s < 16; s++) {
        Serial.print(F("  Sector "));
        if (s < 10) Serial.print(' ');
        Serial.print(s); Serial.print(F(": "));
        if (hitA[s] && hitB[s]) {
            Serial.print(F("A=")); printHex(kA[s], 6);
            Serial.print(F("  B=")); printHex(kB[s], 6);
            hits++;
        } else if (hitA[s]) {
            Serial.print(F("A=")); printHex(kA[s], 6);
            Serial.print(F("   (KeyB unknown)"));
            hits++;
        } else if (hitB[s]) {
            Serial.print(F("B=")); printHex(kB[s], 6);
            Serial.print(F("   (KeyA unknown)"));
            hits++;
        } else {
            Serial.print(F("not recovered"));
        }
        Serial.println();
    }

    Serial.println();
    Serial.print(F("Hit rate: ")); Serial.print(hits);
    Serial.print('/'); Serial.println(16);

    rfid.halt();
    uint32_t ws = millis();
    while ((millis() - ws) < 6000UL) {
        if (!rfid.cardPresentWake()) { break; }
        rfid.halt();
        delay(150);
    }
}
